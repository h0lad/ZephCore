## zephcore/boards/esp32/solarmeshtasticnode/Kconfig.solarmeshtasticnode
```kconfig
# SPDX-License-Identifier: MIT

config BOARD_SOLARMESHTASTICNODE
	select SOC_ESP32C3_MINI_N4
```

## zephcore/boards/esp32/solarmeshtasticnode/board.yml
```yaml
board:
  name: solarmeshtasticnode
  full_name: Solar Meshtastic Node (Heltec HT-CT62)
  vendor: heltec
  socs:
    - name: esp32c3
```

## zephcore/boards/stm32wl/loraharvesterbox/Kconfig.loraharvesterbox
```kconfig
# SPDX-License-Identifier: MIT

config BOARD_LORAHARVESTERBOX
	select SOC_STM32WLE5XX
```

## zephcore/boards/stm32wl/loraharvesterbox/board.yml
```yaml
board:
  name: loraharvesterbox
  full_name: Lora Harvester Box (RAK3172)
  vendor: rakwireless
  socs:
    - name: stm32wle5xx
```
